#include "main.h"
#include "uart.h"
#include "oled.h"

/*----------------------------------------------------------------------------*/
/**@brief 	波特率设置
  @param	
  	info: 
  @return
  @note    

*/
/*----------------------------------------------------------------------------*/
void Uart_Baudset(u32 num)
{
	PCON &= 0x7F;		//波特率不倍速
	SCON = 0x50;		//8位可变波特率	 串口1
	AUXR |= 0x04;		//定时器2时钟为Fosc,即1T
	T2L  = (65536-(MAIN_Fosc/4/num));
	T2H  = (65536-(MAIN_Fosc/4/num))>>8;
	AUXR |= 0x01;		//串口1选择定时器2为波特率发生器
	AUXR |= 0x10;		//启动定时器2
}

void UartInit(void)
{
  Uart_Baudset(BAUD115200);
}

 /*----------------------------------------------------------------------------*/
/**@brief 	串口发数据
  @param	
  	info: 
  @return
  @note    

*/
/*----------------------------------------------------------------------------*/
void put_byte(u8 tmp)   //串口发送数据
{
    SBUF = tmp;	             //SUBF接受/发送缓冲器(又叫串行通信特殊功能寄存器)
    while(!TI);			// 等特数据传送	(TI发送中断标志)
    TI = 0;					// 清除数据传送标志
}  
/*----------------------------------------------------------------------------*/
/**@brief 	发送字符串
  @param	
  	info: 
  @return
  @note    

*/
/*----------------------------------------------------------------------------*/
void send_string(char *s) 
{
   while(*s)
   {
   	  put_char(*s++);
   }

}
/*----------------------------------------------------------------------------*/
/**@brief 	发送字节
  @param	
  	info: 
  @return
  @note    

*/
/*----------------------------------------------------------------------------*/
char put_char (char c)
{     
 	if (c == '\n')
    {
        put_byte(0x0d);
        put_byte(0x0a);
    }
    else
    {
        put_byte(c);
    } 
     return (c);

}

/*----------------------------------------------------------------------------*/
/**@brief 	转十六进制字符
  @param	
  	info: 
  @return
  @note    

*/
/*----------------------------------------------------------------------------*/
void get_hex_data(u8 dat)
{
   u8 dat0;
   if(dat<0x0a)
   {
       dat0 = dat+'0';
   }
   else
   {
       dat0 = dat+'A'-10;
   }
   put_char(dat0);
}  

 /*----------------------------------------------------------------------------*/
/**@brief 	发送十六进制字符
  @param	
  	info: 
  @return
  @note    

*/
/*----------------------------------------------------------------------------*/
void printf_u8(u8 dat)
{
    put_char(' ');
    get_hex_data(dat >> 4);
    get_hex_data(dat & 0xf);
    put_char(' '); 	   

}

void uart1_interrupt(void) interrupt UART1_VECTOR
{ 
    u8 temp;
	if(RI)              //接收中断标志
    {
	     RI = 0;       //清除中断标志 
		 temp = SBUF;

	 }	
    
}